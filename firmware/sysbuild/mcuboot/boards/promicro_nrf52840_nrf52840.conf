## firmware/sysbuild/mcuboot/boards/promicro_nrf52840_nrf52840.conf
```kconfig
# Disable nRF5 bootloader assumption - MCUboot starts at 0x0
CONFIG_BOARD_HAS_NRF5_BOOTLOADER=n

# Disable USB CDC ACM in MCUboot (promicro enables it by default)
CONFIG_USB_DEVICE_STACK=n
CONFIG_SERIAL=n
CONFIG_CONSOLE=n
CONFIG_UART_CONSOLE=n

# Disable QSPI (not present on promicro)
CONFIG_NORDIC_QSPI_NOR=n
```

## west.yml
```yaml
# West manifest for LED Copper String Zigbee Controller
# Uses ncs-zigbee add-on (pulls in nRF Connect SDK v3.1.0)
#
# Setup (from this directory):
#   mkdir .west && echo -e '[manifest]\npath = .\nfile = west.yml\n\n[zephyr]\nbase = deps/zephyr' > .west/config
#   west update
#   ./build.sh

manifest:
  version: "1.0"

  remotes:
    - name: ncs
      url-base: https://github.com/nrfconnect

  defaults:
    remote: ncs

  projects:
    # Zigbee R23 add-on - provides Zigbee support and imports SDK v3.1.0
    - name: ncs-zigbee
      repo-path: ncs-zigbee
      revision: nRF54LM20-preview1
      import:
        path-prefix: deps
```
